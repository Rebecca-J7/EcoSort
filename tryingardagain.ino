#include <Wire.h>
#include <Adafruit_GFX.h>
#include <Adafruit_SSD1306.h>

Adafruit_SSD1306 display(128, 64, &Wire, -1);
const unsigned char compost_sym [] PROGMEM = {
	0x00, 0x00, 0x00, 0x00, 0x00, 0x00, 0x00, 0x00, 0x00, 0x00, 0x00, 0x00, 0x00, 0x00, 0x00, 0x00, 
	0x00, 0x00, 0x00, 0x00, 0x00, 0x00, 0x00, 0x00, 0x00, 0x00, 0x00, 0x00, 0x00, 0x00, 0x00, 0x00, 
	0x00, 0x00, 0x00, 0x00, 0x00, 0x00, 0x00, 0x00, 0x00, 0x00, 0x00, 0x00, 0x00, 0x00, 0x00, 0x00, 
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	0x00, 0x00, 0x00, 0x00, 0x00, 0x07, 0xf0, 0x00, 0x00, 0x00, 0x00, 0x00, 0x00, 0x00, 0x00, 0x00

					};

	const unsigned char recycle_sym [] PROGMEM = {	
		0x00, 0x00, 0x00, 0x00, 0x01, 0xff, 0xff, 0xff, 0xff, 0xfc, 0x00, 0x00, 0x00, 0x00, 0x00, 0x00, 
	0x00, 0x00, 0x00, 0x00, 0x03, 0xff, 0xff, 0xff, 0xff, 0xfe, 0x00, 0x00, 0x00, 0x00, 0x00, 0x00, 
	0x00, 0x00, 0x00, 0x00, 0x03, 0xff, 0xff, 0xff, 0xff, 0xfe, 0x00, 0x00, 0x00, 0x00, 0x00, 0x00, 
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	0x00, 0x00, 0x00, 0x07, 0xff, 0xff, 0xff, 0x87, 0xff, 0xff, 0xff, 0x00, 0x00, 0x00, 0x00, 0x00
		};

const unsigned char trash_sym [] PROGMEM = {	
	0x00, 0x00, 0x00, 0x00, 0x00, 0x00, 0x00, 0x00, 0x00, 0x00, 0x00, 0x00, 0x00, 0x00, 0x00, 0x00, 
	0x00, 0x00, 0x00, 0x00, 0x00, 0x00, 0x00, 0x00, 0x00, 0x00, 0x00, 0x00, 0x00, 0x00, 0x00, 0x00, 
	0x00, 0x00, 0x00, 0x00, 0x00, 0x00, 0x00, 0x00, 0x00, 0x00, 0x00, 0x00, 0x00, 0x00, 0x00, 0x00, 
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	0x00, 0x00, 0x00, 0x00, 0x00, 0x00, 0x00, 0x00, 0x00, 0x00, 0x00, 0x00, 0x00, 0x00, 0x00, 0x00
	};

const unsigned char somefurryshit [] PROGMEM = {	
	0x00, 0x00, 0x00, 0x00, 0x00, 0x00, 0x00, 0x00, 0x00, 0x00, 0x00, 0x00, 0x00, 0x00, 0x00, 0x00, 
	0x00, 0x00, 0x00, 0x00, 0x00, 0x00, 0x00, 0x00, 0x00, 0x00, 0x00, 0x00, 0x00, 0x00, 0x00, 0x00, 
	0x00, 0x00, 0x00, 0x00, 0x00, 0x00, 0x00, 0x00, 0x00, 0x00, 0x00, 0x00, 0x00, 0x00, 0x00, 0x00, 
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	0x00, 0x00, 0x00, 0x00, 0x00, 0x00, 0x00, 0x00, 0x00, 0x00, 0x00, 0x00, 0x00, 0x00, 0x00, 0x00
	};




void setup()
{
  Serial.begin(9600);   // opens serial port, sets data rate to 9600 bps
  display.begin(SSD1306_SWITCHCAPVCC, 0x3C);
  display.clearDisplay();
  display.setTextSize(2.75);
  display.setTextColor(WHITE);
  display.setCursor(0,0);


  }
void loop()
{
    char receiveVal;                  // Defined receive data
   
    if(Serial.available() > 0)       //Receive serial data
    {        
        receiveVal = Serial.read();  //Save the serial data received 
        
       if(receiveVal == '1') {         //Receive data is 1, lit LED lights         { 
         Serial.println("1"); //send data to the serial monitor
         display.clearDisplay();
         display.println("please bring closer");
         display.setCursor(0, 0);
         
         display.display();
       }
          //print out the value of the LED       
          
     
     if(receiveVal == '0')          //Receive data is 0, off LED lights
     { 
         Serial.println("0"); //send data to the serial monitor
         display.clearDisplay(); //print out the value of the LED  
         display.setCursor(0, 0);
         display.display();              
    } 
     if(receiveVal == '2')          //Receive data is 0, off LED lights
     { 
         display.clearDisplay();
         display.display();

				 display.drawBitmap(0,0,compost_sym,128,64,1);
         delay(500);
         display.setCursor(0, 0);
         
         display.display();
       }   

			  if(receiveVal == '3')          //Receive data is 0, off LED lights
     { 
         display.clearDisplay();
         display.display();

				 display.drawBitmap(0,0,recycle_sym,128,64,1);
         delay(500);
         display.setCursor(0, 0);
         
         display.display();
       }      
			   if(receiveVal == '4')          //Receive data is 0, off LED lights
     { 
         display.clearDisplay();
         display.display();

				 display.drawBitmap(0,0,trash_sym,128,64,1);
         delay(500);
         display.setCursor(0, 0);
         
         display.display();
       }    
  				if(receiveVal == '5')   
			  { 
					display.setTextSize(3.5);
         display.clearDisplay();
         display.display();

				 display.drawBitmap(0,0,somefurryshit,128,64,1);
         delay(500);
         display.setCursor(0, 0);
         
         display.display();
       }
		}
}
    



  
                    //delay 50ms


