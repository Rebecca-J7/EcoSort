// arduino file, talks to and recieves messages from the esp32-s3-cam
// ESP32-S3-CAM <--> Arduino Uno

#include "timerISR.h"
#include <Adafruit_GFX.h>
#include <Adafruit_SSD1306.h>
#include <Servo.h>
#include <Wire.h>

#define NUM_TASKS 3
#define pinL 9
#define pinR 10
#define pinC 11



// serial fct task 1
// servo fct task 2
// diaplay fc task 3

// global variables
String inputBuffer = "";
String cmd; // line recieved from serial

Adafruit_SSD1306 display(128, 64, &Wire, -1);

const unsigned char compost_sym [] PROGMEM = {
  0x00, 0x00, 0x00, 0x00, 0x00, 0x00, 0x00, 0x00, 0x00, 0x00, 0x00, 0x00, 0x00, 0x00, 0x00, 0x00, 
  0x00, 0x00, 0x00, 0x00, 0x00, 0x00, 0x00, 0x00, 0x00, 0x00, 0x00, 0x00, 0x00, 0x00, 0x00, 0x00, 
  0x00, 0x00, 0x00, 0x00, 0x00, 0x00, 0x00, 0x00, 0x00, 0x00, 0x00, 0x00, 0x00, 0x00, 0x00, 0x00, 
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  0x00, 0x00, 0x00, 0x00, 0x00, 0x07, 0xf0, 0x00, 0x00, 0x00, 0x00, 0x00, 0x00, 0x00, 0x00, 0x00

          };

  const unsigned char recycle_sym [] PROGMEM = {  
    0x00, 0x00, 0x00, 0x00, 0x01, 0xff, 0xff, 0xff, 0xff, 0xfc, 0x00, 0x00, 0x00, 0x00, 0x00, 0x00, 
    0x00, 0x00, 0x00, 0x00, 0x03, 0xff, 0xff, 0xff, 0xff, 0xfe, 0x00, 0x00, 0x00, 0x00, 0x00, 0x00, 
    0x00, 0x00, 0x00, 0x00, 0x03, 0xff, 0xff, 0xff, 0xff, 0xfe, 0x00, 0x00, 0x00, 0x00, 0x00, 0x00, 
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    0x00, 0x00, 0x00, 0x07, 0xff, 0xff, 0xff, 0x87, 0xff, 0xff, 0xff, 0x00, 0x00, 0x00, 0x00, 0x00
      };

const unsigned char trash_sym [] PROGMEM = {  
  0x00, 0x00, 0x00, 0x00, 0x00, 0x00, 0x00, 0x00, 0x00, 0x00, 0x00, 0x00, 0x00, 0x00, 0x00, 0x00, 
  0x00, 0x00, 0x00, 0x00, 0x00, 0x00, 0x00, 0x00, 0x00, 0x00, 0x00, 0x00, 0x00, 0x00, 0x00, 0x00, 
  0x00, 0x00, 0x00, 0x00, 0x00, 0x00, 0x00, 0x00, 0x00, 0x00, 0x00, 0x00, 0x00, 0x00, 0x00, 0x00, 
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  0x00, 0x00, 0x00, 0x00, 0x00, 0x00, 0x00, 0x00, 0x00, 0x00, 0x00, 0x00, 0x00, 0x00, 0x00, 0x00
  };

const unsigned char somefurryshit [] PROGMEM = {  

  0x00, 0x00, 0x00, 0x00, 0x00, 0x00, 0x00, 0x00, 0x00, 0x00, 0x00, 0x00, 0x00, 0x00, 0x00, 0x00, 
  0x00, 0x00, 0x00, 0x00, 0x00, 0x00, 0x00, 0x00, 0x00, 0x00, 0x00, 0x00, 0x00, 0x00, 0x00, 0x00, 
  0x00, 0x00, 0x00, 0x00, 0x00, 0x00, 0x00, 0x00, 0x00, 0x00, 0x00, 0x00, 0x00, 0x00, 0x00, 0x00, 
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  0x00, 0x00, 0x00, 0x00, 0x00, 0x00, 0x00, 0x00, 0x00, 0x00, 0x00, 0x00, 0x00, 0x00, 0x00, 0x00
  };


// servo declarations
Servo leftServo;
Servo rightServo;
Servo centerServo;
//when closing, we go to (servo).write(95)
//when opening, we go to (servo).write(0)

int openCount = 0; // tracks how long the bin is open, only for 2 seconds 
int displayCount = 0; // tracks 2 seconds for open bin as well as the thank you message for 1 second
int writeCount = 0; // tracks when the display writes to the screen


// tasks period
const unsigned long TASK1_PERIOD = 50; // placeholder values
const unsigned long TASK2_PERIOD = 20; // placeholder values
const unsigned long TASK3_PERIOD = 100; // placeholder values
const unsigned long GCD_PERIOD = 10;

typedef struct _task{
	signed 	 char state; 		//Task's current state
	unsigned long period; 		//Task period
	unsigned long elapsedTime; 	//Time elapsed since last task tick
	int (*TickFct)(int); 		//Task tick function
} task;

task tasks[NUM_TASKS];

void TimerISR() {
	for ( unsigned int i = 0; i < NUM_TASKS; i++ ) {                   // Iterate through each task in the task array
		if ( tasks[i].elapsedTime == tasks[i].period ) {           // Check if the task is ready to tick
			tasks[i].state = tasks[i].TickFct(tasks[i].state); // Tick and set the next state for this task
			tasks[i].elapsedTime = 0;                          // Reset the elapsed time for the next tick
		}
		tasks[i].elapsedTime += GCD_PERIOD;                        // Increment the elapsed time by GCD_PERIOD
	}
}

enum serialStates{waitSerial, reading};
enum servoStates{waitServo, openLeft, openMiddle, openRight, done};
enum displayStates{waitDisplay, closer, holdStill, detectedL, detectedC, detectedR, thanksDisplay};

int TickFct_Serial(int state){
  switch(state){ // transitions
    case waitSerial:
      if (Serial.available()) {state = reading;}
      break;

    case reading:
      if (!Serial.available()) {state = waitSerial;}
      break;
  }

  switch(state){ // actions
    case waitSerial:
      break;

    case reading:
      char c = Serial.read();

      if (c == '\n') {
          cmd = inputBuffer;
          inputBuffer = "";
      } 
      else {
          inputBuffer += c;
      }
      break;
  }

  return state;  
}

int TickFct_Servo(int state){
  switch(state){ // transitions
    case waitServo:
      if (cmd == "Landfill") {state = openLeft;}
      else if (cmd == "Recycling") {state = openRight;}
      else if (cmd == "Compost") {state = openMiddle;}
      else {cmd = "";}
      break;

    case openLeft:
      if (openCount >= 100) {state = done;}
      break;

    case openMiddle:
      if (openCount >= 100) {state = done;}
      break;

    case openRight:
      if (openCount >= 100) {state = done;}
      break;

    case done:
      cmd = "";
      openCount = 0;
      state = waitServo;
      break;
  }
  Serial.println("current read statement:");
  Serial.println(cmd);

  switch(state){ // actions
    case waitServo:
      leftServo.write(95);
      rightServo.write(95);
      centerServo.write(95);
      break;

    case openLeft:
      leftServo.write(0);
      rightServo.write(95);
      centerServo.write(95);
      openCount++;
      break;

    case openMiddle:
      leftServo.write(95);
      rightServo.write(95);
      centerServo.write(0);
      openCount++;
      break;

    case openRight:
      leftServo.write(95);
      rightServo.write(0);
      centerServo.write(95);
      openCount++;
      break;

    case done:
      break;
  }

  return state;
}

int TickFct_Display(int state){
  switch(state){ // transitions
    case waitDisplay:
      if (cmd == "hold Closer") {state = closer; writeCount = 0;}
      else if (cmd == "hold still") {state = holdStill; writeCount = 0;}
      else if (cmd == "Landfill") {state = detectedL; writeCount = 0;}
      else if (cmd == "Recycling") {state = detectedC; writeCount = 0;}
      else if (cmd == "Compost") {state = detectedR; writeCount = 0;}
      break;

    case closer:
      if (cmd == "holdStill") {state = holdStill; writeCount = 0;}
      else if (cmd == "Landfill") {state = detectedL; writeCount = 0;}
      else if (cmd == "Recycling") {state = detectedC; writeCount = 0;}
      else if (cmd == "Compost") {state = detectedR; writeCount = 0;}
      break;

    case holdStill:
      if (cmd == "closer") {state = closer; writeCount = 0;}
      else if (cmd == "Landfill") {state = detectedL; writeCount = 0;}
      else if (cmd == "Recycling") {state = detectedC; writeCount = 0;}
      else if (cmd == "Compost") {state = detectedR; writeCount = 0;}
      break;

    case detectedL:
      if (displayCount >= 40) {state = thanksDisplay; writeCount = 0; }
      break;

    case detectedC:
      if (displayCount >= 40) {state = thanksDisplay; writeCount = 0; }
      break;

    case detectedR:
      if (displayCount >= 40) {state = thanksDisplay; writeCount = 0;}
      break;

    case thanksDisplay:
      if (displayCount >= 20) {state = waitDisplay; writeCount = 0;}
      break;
  }

  switch(state){ // actions
    case waitDisplay:
      // if (writeCount < 1){
      //   display.clearDisplay();
      //   display.setCursor(0,0);
      //   display.display();
      //   writeCount++;
      // }
      break;

    case closer:
    // if (writeCount < 1){
    //   display.clearDisplay();
    //   display.println("please bring closer");
    //   display.setCursor(0,0);
    //   display.display();
    //   writeCount++;
    // }
      break;

    case holdStill:
      // if (writeCount < 1){
      //   display.clearDisplay();
      // display.println("hold still");
      // display.setCursor(0,0);
      // display.display();
      //   writeCount++;
      // }
      
      break;

    case detectedL:
      // if (writeCount < 1){
      //   display.clearDisplay();
      // display.display();

      // display.println("trash");
      // display.setCursor(0,0);

      // display.display();
      //   writeCount++;
      // }

      // displayCount++;
      break;

    case detectedC:
      // if (writeCount < 1){
      // display.clearDisplay();
      // display.display();

      // display.println("recycling");
      // display.setCursor(0,0);

      // display.display();
      //   writeCount++;
      // }

      // displayCount++;
      break;

    case detectedR:
      // if (writeCount < 1){
      //   display.clearDisplay();
      // display.display();

      // display.println("compost");
      // display.setCursor(0,0);

      // display.display();
      //   writeCount++;
      // }

      // displayCount++;
      break;

    case thanksDisplay:

      // if (writeCount < 1){
      //         display.setTextSize(3.5);
      // display.clearDisplay();
      // display.display();

      // display.println("thanks =P");
      // display.setCursor(0, 0);
         
      // display.display();
      //   writeCount++;
      // }

      // displayCount++;
      break;
  }

  return state;
}

void setup() {
  Serial.begin(115200);
//115200
  leftServo.attach(pinL);
  rightServo.attach(pinR);
  centerServo.attach(pinC);

  //display configuration
  // display.begin(SSD1306_SWITCHCAPVCC, 0x3C);
  // display.clearDisplay();
  // display.setTextSize(2);
  // display.setTextColor(WHITE);
  // display.setCursor(0,0);
  // display.display();

  unsigned i = 0;
  tasks[i].period = TASK1_PERIOD;
  tasks[i].state = waitSerial;
  tasks[i].elapsedTime = tasks[i].period;
  tasks[i].TickFct = &TickFct_Serial;
  i++;
  tasks[i].period = TASK2_PERIOD;
  tasks[i].state = waitServo;
  tasks[i].elapsedTime = tasks[i].period;
  tasks[i].TickFct = &TickFct_Servo;
  i++;
  tasks[i].period = TASK3_PERIOD;
  tasks[i].state = waitDisplay;
  tasks[i].elapsedTime = tasks[i].period;
  tasks[i].TickFct = &TickFct_Display;

  TimerSet(GCD_PERIOD);
  TimerOn();
}

void loop() {
 // blehhhhhh :P
}
